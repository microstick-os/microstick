## buildroot-external/Config.in
```kconfig
menu "MSM8916 microstick"
source "$BR2_EXTERNAL_MICROSTICK_PATH/package/microstick-qrtr/Config.in"
source "$BR2_EXTERNAL_MICROSTICK_PATH/package/microstick-rmtfs/Config.in"
source "$BR2_EXTERNAL_MICROSTICK_PATH/package/microstick-regdb/Config.in"
source "$BR2_EXTERNAL_MICROSTICK_PATH/package/microstick-core/Config.in"
source "$BR2_EXTERNAL_MICROSTICK_PATH/package/microstick-statistics/Config.in"
endmenu
```

## buildroot-external/configs/msm8916_microstick_defconfig
```kconfig
BR2_aarch64=y
BR2_cortex_a53=y
BR2_TOOLCHAIN_BUILDROOT_MUSL=y
BR2_KERNEL_HEADERS_5_15=y
BR2_OPTIMIZE_S=y
BR2_REPRODUCIBLE=y
BR2_PRIMARY_SITE="https://sources.buildroot.net"
BR2_GLOBAL_PATCH_DIR="$(BR2_EXTERNAL_MICROSTICK_PATH)/patches"
BR2_TARGET_GENERIC_HOSTNAME="microstick"
BR2_TARGET_GENERIC_ISSUE="MSM8916 Buildroot"
BR2_ROOTFS_DEVICE_CREATION_DYNAMIC_EUDEV=y
BR2_TARGET_GENERIC_ROOT_PASSWD="!"
# BR2_TARGET_GENERIC_GETTY is not set
BR2_ROOTFS_OVERLAY="$(BR2_EXTERNAL_MICROSTICK_PATH)/board/msm8916/overlay"
BR2_ROOTFS_POST_BUILD_SCRIPT="$(BR2_EXTERNAL_MICROSTICK_PATH)/scripts/post-build.sh"
BR2_ROOTFS_POST_IMAGE_SCRIPT="$(BR2_EXTERNAL_MICROSTICK_PATH)/scripts/post-image.sh"
BR2_PACKAGE_BUSYBOX_CONFIG_FRAGMENT_FILES="$(BR2_EXTERNAL_MICROSTICK_PATH)/board/msm8916/busybox.fragment"
BR2_PACKAGE_EUDEV_MODULE_LOADING=y
# BR2_PACKAGE_EUDEV_ENABLE_HWDB is not set
BR2_PACKAGE_KMOD_TOOLS=y
# BR2_PACKAGE_UTIL_LINUX_BINARIES is not set
BR2_PACKAGE_DBUS=y
BR2_PACKAGE_MODEM_MANAGER=y
BR2_PACKAGE_MODEM_MANAGER_LIBQMI=y
BR2_PACKAGE_MODEM_MANAGER_LIBQRTR=y
BR2_PACKAGE_MICROSTICK_RMTFS=y
BR2_PACKAGE_MICROSTICK_REGDB=y
BR2_PACKAGE_HOSTAPD=y
BR2_PACKAGE_HOSTAPD_DRIVER_NL80211=y
# BR2_PACKAGE_HOSTAPD_EAP is not set
BR2_PACKAGE_WPA_SUPPLICANT=y
BR2_PACKAGE_WPA_SUPPLICANT_NL80211=y
BR2_PACKAGE_WPA_SUPPLICANT_CLI=y
BR2_PACKAGE_WPA_SUPPLICANT_PASSPHRASE=y
# BR2_PACKAGE_WPA_SUPPLICANT_EAP is not set
BR2_PACKAGE_DNSMASQ=y
# BR2_PACKAGE_DNSMASQ_TFTP is not set
BR2_PACKAGE_IPTABLES=y
BR2_PACKAGE_NFTABLES=y
BR2_PACKAGE_IPROUTE2=y
BR2_PACKAGE_IW=y
BR2_PACKAGE_UTIL_LINUX_RFKILL=y
BR2_PACKAGE_JQ=y
# BR2_PACKAGE_JQ_ONIGURUMA is not set
BR2_PACKAGE_DROPBEAR=y
BR2_PACKAGE_DROPBEAR_SMALL=y
BR2_PACKAGE_DROPBEAR_DISABLE_REVERSEDNS=y
# BR2_PACKAGE_DROPBEAR_CLIENT is not set
BR2_PACKAGE_LIBCURL=y
BR2_PACKAGE_LIBCURL_CURL=y
BR2_PACKAGE_LIBCURL_OPENSSL=y
# BR2_PACKAGE_LIBCURL_EXTRA_PROTOCOLS_FEATURES is not set
BR2_PACKAGE_CA_CERTIFICATES=y
BR2_PACKAGE_HTOP=y
BR2_PACKAGE_ANDROID_TOOLS=y
BR2_PACKAGE_ANDROID_TOOLS_ADBD=y
BR2_TARGET_ROOTFS_EXT2=y
BR2_TARGET_ROOTFS_EXT2_4=y
BR2_TARGET_ROOTFS_EXT2_SIZE="256M"
BR2_TARGET_ROOTFS_EXT2_MKFS_OPTIONS="-O ^64bit,^metadata_csum_seed,^orphan_file -m 0"
BR2_TARGET_ROOTFS_TAR=y
BR2_PACKAGE_HOST_QEMU=y
BR2_PACKAGE_HOST_QEMU_LINUX_USER_MODE=y

BR2_PACKAGE_MICROSTICK_CORE=y
BR2_PACKAGE_MOBILE_BROADBAND_PROVIDER_INFO=y

BR2_PACKAGE_MICROSTICK_STATISTICS=y

BR2_PACKAGE_AVAHI=y
BR2_PACKAGE_AVAHI_DAEMON=y
# BR2_PACKAGE_AVAHI_AUTOIPD is not set
# BR2_PACKAGE_AVAHI_DEFAULT_SERVICES is not set

BR2_PACKAGE_E2FSPROGS=y
BR2_PACKAGE_E2FSPROGS_RESIZE2FS=y
```

## buildroot-external/package/microstick-core/Config.in
```kconfig
config BR2_PACKAGE_MICROSTICK_CORE
 bool "microstick core and default web plugin"
 select BR2_PACKAGE_CJSON
 select BR2_PACKAGE_LIBMICROHTTPD
 select BR2_PACKAGE_OPENSSL
 select BR2_PACKAGE_LIBMNL
 select BR2_PACKAGE_LIBNFTNL
 select BR2_PACKAGE_IPTABLES
 select BR2_PACKAGE_LIBCURL
 select BR2_PACKAGE_AVAHI
 select BR2_PACKAGE_AVAHI_DAEMON
```

## buildroot-external/package/microstick-qrtr/Config.in
```kconfig
config BR2_PACKAGE_MICROSTICK_QRTR
	bool "Qualcomm IPC router tools (QRTR)"
	depends on BR2_TOOLCHAIN_HAS_THREADS
```

## buildroot-external/package/microstick-regdb/Config.in
```kconfig
config BR2_PACKAGE_MICROSTICK_REGDB
	bool "regdb signed by the kernel's sforshee key"
```

## buildroot-external/package/microstick-rmtfs/Config.in
```kconfig
config BR2_PACKAGE_MICROSTICK_RMTFS
	bool "Qualcomm remote filesystem service (rmtfs)"
	depends on BR2_PACKAGE_HAS_UDEV
	depends on BR2_TOOLCHAIN_HAS_THREADS
	select BR2_PACKAGE_MICROSTICK_QRTR
```

## buildroot-external/package/microstick-statistics/Config.in
```kconfig
config BR2_PACKAGE_MICROSTICK_STATISTICS
 bool "microstick statistics default plugin"
 select BR2_PACKAGE_CJSON
 select BR2_PACKAGE_LIBMNL
 select BR2_PACKAGE_LIBNFTNL
 help
   Independent optional C traffic collector. LTE durable, Wi-Fi RAM only.
```
